## components/ruth/Kconfig
```kconfig
menu "Ruth"

config RUTH_ENV
	string "Execution Environment"
	default "prod"
	help
		Build for operation in a specific environment.

menu "Network"
	config WIFI_SSID
	    string "WiFi SSID"
		default "WissLanding"
		help
			SSID (network name)

	config WIFI_PASSWORD
	    string "WiFi Password"
		default "password"
		help
			WiFi password (WPA or WPA2)
	endmenu

menu "IoT"
	config RUTH_IOT_ENDPOINT
		bool "Use IoT Endpoint"
		default y
		select RUTH_MQTT_CONFIG
		select RUTH_IOT_TASKS

		config RUTH_MQTT_CONFIG
			depends on RUTH_IOT_ENDPOINT
			bool "Configure IoT Endpoint"
			default y


		config RUTH_MQTT_HOST
			depends on RUTH_MQTT_CONFIG
			string "IoT Endpoint Host"
			default "jophiel.wisslanding.com"
			help
				Endpoint host name for the IoT MQTT/S gateway

		config RUTH_MQTT_PORT
			depends on RUTH_MQTT_CONFIG
			int "IoT Endpoint Port"
			default 1883
			range 0 65535
			help
				Endpoint port for the IoT MQTT/S gateway

		config RUTH_MQTT_USER
			depends on RUTH_MQTT_CONFIG
			string "IoT Endpoint User"
			default "mqtt"
			help
				User name for connecting to the IoT MQTT/S gateway

		config RUTH_MQTT_PASSWD
			depends on RUTH_MQTT_CONFIG
			string "IoT Endpoint Password"
			default "mqtt"
			help
				Password for connecting to the IoT MQTT/S gateway

	endmenu

endmenu
```
